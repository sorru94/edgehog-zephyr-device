## CMakeLists.txt
```
# (C) Copyright 2024, SECO Mind Srl
#
# SPDX-License-Identifier: Apache-2.0

function(concat_if_exists FILE_PATH STRING_NAME)
    # Check if the file exists
    file(GLOB FILE_TO_ADD ${FILE_PATH})

    # If the file exists, add it to the list
    if(EXISTS ${FILE_TO_ADD})
        set(${STRING_NAME} "${${STRING_NAME}};${FILE_PATH}" PARENT_SCOPE)
    endif()
endfunction()

cmake_minimum_required(VERSION 3.20.0)

# add private configuration for common modules before declaring the zephyr project
concat_if_exists(${CMAKE_CURRENT_LIST_DIR}/private.conf EXTRA_CONF_FILE)

find_package(Zephyr REQUIRED HINTS $ENV{ZEPHYR_BASE})
project(edgehog_app)

FILE(GLOB app_sources src/*.c)
if(NOT CONFIG_WIFI)
    LIST(REMOVE_ITEM app_sources src/wifi.c)
endif()

# Verify that this sample is built through sysbuild to ensure MCUboot is
# automatically included and that sample specific MCUboot configurations are
# used when building MCUboot.
test_sysbuild()

target_include_directories(app PRIVATE src/include)
target_sources(app PRIVATE ${app_sources})
```

## Kconfig
```
# (C) Copyright 2024, SECO Mind Srl
#
# SPDX-License-Identifier: Apache-2.0
#
# This file is the application Kconfig entry point. All application Kconfig
# options can be defined here or included via other application Kconfig files.
# You can browse these options using the west targets menuconfig (terminal) or
# guiconfig (GUI).

menu "Zephyr"
source "Kconfig.zephyr"
endmenu

rsource "../../Kconfig"

menu "Sample application"

config CONFIG_FROM_FLASH
    bool "Collect the configuration from flash"
    help
        Collect the configuration from a file in the dedicated flash partition.

config WIFI_SSID
    string "WiFi SSID"
	depends on WIFI
    depends on !CONFIG_FROM_FLASH
    default ""
	help
	  WiFi access point SSID.

config WIFI_PASSWORD
    string "WiFi password"
	depends on WIFI
    depends on !CONFIG_FROM_FLASH
    default ""
    help
        WiFi access point password.

config ASTARTE_DEVICE_ID
	string "Astarte device ID"
    depends on !CONFIG_FROM_FLASH
    default ""
	help
	  Device ID to be used to connect to Astarte.

config ASTARTE_CREDENTIAL_SECRET
    string "Astarte credential secret"
    depends on !CONFIG_FROM_FLASH
    default ""
    help
        The credential secret to be used to connect to Astarte.

config SAMPLE_DURATION_SECONDS
    int "Sample maximum duration (s)"
    default 240
    help
        Use this setting to change for how long the sample will run.
        The default is four minutes.

config EDGEHOG_DEVICE_THREAD_STACK_SIZE
    int "Edgehog device thread stack size (Bytes)"
    default 16384
    help
        Use this setting to change the size of the stack for the thread running the Astarte device.

config EDGEHOG_DEVICE_THREAD_PRIORITY
    int "Edgehog device thread priority"
    default 0
    help
        Use this setting to change the priority of the Astarte device thread.

config ZBUS_THREAD_STACK_SIZE
    int "Zbus thread stack size (Bytes)"
    default 16384
    help
        Use this setting to change the size of the stack for the thread running the Zbus subscriber.

config ZBUS_THREAD_PRIORITY
    int "Zbus thread priority"
    default 0
    help
        Use this setting to change the priority of the Zbus subscriber thread.

endmenu

module = APP
module-str = APP
source "subsys/logging/Kconfig.template.log_config"
```

## prj.conf
```kconfig
# (C) Copyright 2024, SECO Mind Srl
#
# SPDX-License-Identifier: Apache-2.0
#
# This is a Kconfig fragment which can be used to enable debug-related options
# in the application. See the README for more details.

# Astarte device SDK
CONFIG_ASTARTE_DEVICE_SDK=y
CONFIG_ASTARTE_DEVICE_SDK_HOSTNAME="."
# The two certificate tags are the same as the root CA is the same for Astarte API and MQTT broker.
CONFIG_ASTARTE_DEVICE_SDK_HTTPS_CA_CERT_TAG=1
CONFIG_ASTARTE_DEVICE_SDK_MQTTS_CA_CERT_TAG=1
CONFIG_ASTARTE_DEVICE_SDK_CLIENT_CERT_TAG=2
CONFIG_ASTARTE_DEVICE_SDK_PAIRING_JWT=""
CONFIG_ASTARTE_DEVICE_SDK_REALM_NAME="."

# Edgehog device
CONFIG_EDGEHOG_DEVICE=y
CONFIG_EDGEHOG_DEVICE_OTA_HTTPS_CA_CERT_TAG=3
CONFIG_EDGEHOG_DEVICE_ZBUS_OTA_EVENT=y
# System info interface data
CONFIG_EDGEHOG_DEVICE_PART_NUMBER=""
CONFIG_EDGEHOG_DEVICE_SERIAL_NUMBER=""

# Sample configuration
CONFIG_ASTARTE_CREDENTIAL_SECRET="."
CONFIG_ASTARTE_DEVICE_ID="......................"

CONFIG_LOG=y
CONFIG_REQUIRES_FLOAT_PRINTF=y
CONFIG_CBPRINTF_FP_SUPPORT=y

# Increase minimum heap size.
CONFIG_HEAP_MEM_POOL_SIZE=16384

# Increased stack size
CONFIG_MAIN_STACK_SIZE=8192

# Enable base64 encoding and decoding
CONFIG_BASE64=y

# Enable system hashmaps
CONFIG_SYS_HASH_MAP=y

# Enable JSON library
CONFIG_JSON_LIBRARY=y

# Enable entropy generator
CONFIG_ENTROPY_GENERATOR=y

# DNS resolver
CONFIG_DNS_RESOLVER=y
CONFIG_DNS_SERVER_IP_ADDRESSES=y
CONFIG_DNS_SERVER1="8.8.8.8" # Google DNS

# Base MbedTLS & heap configuration
CONFIG_MBEDTLS=y
CONFIG_MBEDTLS_BUILTIN=y
CONFIG_MBEDTLS_ENABLE_HEAP=y
CONFIG_MBEDTLS_HEAP_SIZE=95000

# Enable PSA Crypto Backend
CONFIG_PSA_CRYPTO=y
CONFIG_PSA_CRYPTO_ENABLE_ALL=y
CONFIG_MBEDTLS_PSA_CRYPTO_C=y

# TLS & X.509
CONFIG_MBEDTLS_SSL_MAX_CONTENT_LEN=8192
CONFIG_MBEDTLS_PEM_PARSE_C=y
CONFIG_MBEDTLS_PEM_WRITE_C=y
CONFIG_MBEDTLS_BASE64_C=y
CONFIG_MBEDTLS_PK_WRITE_C=y
CONFIG_MBEDTLS_SSL_PROTO_TLS1_2=y
CONFIG_MBEDTLS_SSL_SERVER_NAME_INDICATION=y
CONFIG_MBEDTLS_X509_USE_C=y
CONFIG_MBEDTLS_X509_CRT_PARSE_C=y
CONFIG_MBEDTLS_X509_CRL_PARSE_C=y
CONFIG_MBEDTLS_X509_CSR_PARSE_C=y
CONFIG_MBEDTLS_X509_CSR_WRITE_C=y
CONFIG_MBEDTLS_PKCS5_C=y
CONFIG_MBEDTLS_KEY_EXCHANGE_ECDHE_ECDSA_ENABLED=y
CONFIG_MBEDTLS_KEY_EXCHANGE_ECDHE_RSA_ENABLED=y

# Enable networking
CONFIG_NETWORKING=y

# Sockets
CONFIG_NET_SOCKETS=y
CONFIG_NET_SOCKETS_SOCKOPT_TLS=y

# Use DHCP for IPv4 and IPv6
CONFIG_NET_DHCPV4=y
CONFIG_NET_DHCPV6=y

# Generic networking options
CONFIG_NET_MGMT_EVENT_STACK_SIZE=4096
CONFIG_NET_TX_STACK_SIZE=4096
CONFIG_NET_RX_STACK_SIZE=4096
CONFIG_NET_PKT_RX_COUNT=20
CONFIG_NET_PKT_TX_COUNT=20
CONFIG_NET_BUF_RX_COUNT=40
CONFIG_NET_BUF_TX_COUNT=40
CONFIG_NET_MAX_CONTEXTS=20
CONFIG_NET_MAX_CONN=6
CONFIG_NET_MGMT=y
CONFIG_NET_MGMT_EVENT=y
CONFIG_NET_IPV4=y
CONFIG_NET_IPV6=y
CONFIG_NET_TCP=y

# Enable HTTP client
CONFIG_HTTP_CLIENT=y

# MQTT options
CONFIG_MQTT_LIB=y
CONFIG_MQTT_LIB_TLS=y
CONFIG_MQTT_KEEPALIVE=60

# Enable flash
CONFIG_FLASH=y
CONFIG_FLASH_MAP=y
CONFIG_FLASH_PAGE_LAYOUT=y

# Enable NVS
CONFIG_NVS=y
CONFIG_NVS_LOG_LEVEL_WRN=y

# Configure the name of the binary
# This will also be used to identify the edgehog image
CONFIG_KERNEL_BIN_NAME="sample-edgehog-app"

# Edgehog depends on
CONFIG_IMG_MANAGER=y
CONFIG_STREAM_FLASH=y
CONFIG_REBOOT=y

CONFIG_DNS_RESOLVER_AI_MAX_ENTRIES=4
CONFIG_NET_SOCKETS_TLS_MAX_CONTEXTS=4
CONFIG_TLS_MAX_CREDENTIALS_NUMBER=8

CONFIG_THREAD_MONITOR=y
CONFIG_INIT_STACKS=y
CONFIG_THREAD_STACK_INFO=y

CONFIG_ZVFS_OPEN_MAX=26

CONFIG_SNTP=y
CONFIG_NET_CONFIG_CLOCK_SNTP_INIT=y
CONFIG_NET_CONFIG_SNTP_INIT_SERVER="0.pool.ntp.org"
CONFIG_NET_CONFIG_SNTP_INIT_TIMEOUT=3000

# Enable the settings
CONFIG_SETTINGS=y

# Activate Zbus
CONFIG_ZBUS=y

# Activate thread naming
CONFIG_THREAD_NAME=y

# Zephyr Kernel & Filesystem Additions
CONFIG_EVENTS=y
CONFIG_FILE_SYSTEM=y
CONFIG_FILE_SYSTEM_LITTLEFS=y

# Increase the system workqueue stack
CONFIG_SYSTEM_WORKQUEUE_STACK_SIZE=4096

# Enable UUID
CONFIG_UUID=y
CONFIG_UUID_V4=y
CONFIG_UUID_V5=y
CONFIG_UUID_BASE64=y

# Enable LZ4 compression
CONFIG_LZ4=y
CONFIG_LZ4_FRAME_SUPPORT=y

# Enable scoped cleanup helpers
CONFIG_SCOPE_CLEANUP_HELPERS=y
```

## prj-zephyr-msv.conf
```kconfig
# (C) Copyright 2026, SECO Mind Srl
#
# SPDX-License-Identifier: Apache-2.0
#
# This is a Kconfig fragment which can be used to enable debug-related options
# in the application. See the README for more details.

# Astarte device SDK
CONFIG_ASTARTE_DEVICE_SDK=y
CONFIG_ASTARTE_DEVICE_SDK_HOSTNAME="."
# The two certificate tags are the same as the root CA is the same for Astarte API and MQTT broker.
CONFIG_ASTARTE_DEVICE_SDK_HTTPS_CA_CERT_TAG=1
CONFIG_ASTARTE_DEVICE_SDK_MQTTS_CA_CERT_TAG=1
CONFIG_ASTARTE_DEVICE_SDK_CLIENT_CERT_TAG=2
CONFIG_ASTARTE_DEVICE_SDK_PAIRING_JWT=""
CONFIG_ASTARTE_DEVICE_SDK_REALM_NAME="."

# Edgehog device
CONFIG_EDGEHOG_DEVICE=y
CONFIG_EDGEHOG_DEVICE_OTA_HTTPS_CA_CERT_TAG=3
CONFIG_EDGEHOG_DEVICE_ZBUS_OTA_EVENT=y
# System info interface data
CONFIG_EDGEHOG_DEVICE_PART_NUMBER=""
CONFIG_EDGEHOG_DEVICE_SERIAL_NUMBER=""

# Sample configuration
CONFIG_ASTARTE_CREDENTIAL_SECRET="."
CONFIG_ASTARTE_DEVICE_ID="......................"

CONFIG_LOG=y
CONFIG_REQUIRES_FLOAT_PRINTF=y
CONFIG_CBPRINTF_FP_SUPPORT=y

# Increase minimum heap size.
CONFIG_HEAP_MEM_POOL_SIZE=16384

# Increased stack size
CONFIG_MAIN_STACK_SIZE=8192

# Use custom heap
CONFIG_ASTARTE_DEVICE_SDK_ENABLE_HEAP=y

# Enable base64 encoding and decoding
CONFIG_BASE64=y

# Enable system hashmaps
CONFIG_SYS_HASH_MAP=y

# Enable JSON library
CONFIG_JSON_LIBRARY=y

# Enable entropy generator
CONFIG_ENTROPY_GENERATOR=y

# DNS resolver
CONFIG_DNS_RESOLVER=y
CONFIG_DNS_SERVER_IP_ADDRESSES=y
CONFIG_DNS_SERVER1="8.8.8.8" # Google DNS

# Base MbedTLS & heap configuration
CONFIG_MBEDTLS=y
CONFIG_MBEDTLS_BUILTIN=y
CONFIG_MBEDTLS_ENABLE_HEAP=y
CONFIG_MBEDTLS_HEAP_SIZE=55000

# Enable PSA Crypto Backend
CONFIG_PSA_CRYPTO=y
CONFIG_PSA_CRYPTO_ENABLE_ALL=y
CONFIG_MBEDTLS_USE_PSA_CRYPTO=y
CONFIG_MBEDTLS_PSA_CRYPTO_C=y

# TLS & X.509
CONFIG_MBEDTLS_SSL_MAX_CONTENT_LEN=8192
CONFIG_MBEDTLS_PEM_CERTIFICATE_FORMAT=y
CONFIG_MBEDTLS_PK_WRITE_C=y
CONFIG_MBEDTLS_SSL_PROTO_TLS1_2=y
CONFIG_MBEDTLS_SERVER_NAME_INDICATION=y
CONFIG_MBEDTLS_X509_CRL_PARSE_C=y
CONFIG_MBEDTLS_X509_CSR_PARSE_C=y
CONFIG_MBEDTLS_X509_CSR_WRITE_C=y
CONFIG_MBEDTLS_PKCS5_C=y
CONFIG_MBEDTLS_GENPRIME_ENABLED=y
CONFIG_MBEDTLS_KEY_EXCHANGE_ECDHE_ECDSA_ENABLED=y
CONFIG_MBEDTLS_KEY_EXCHANGE_ECDHE_RSA_ENABLED=y
CONFIG_MBEDTLS_ECDH_C=y
CONFIG_MBEDTLS_ECDSA_C=y
CONFIG_MBEDTLS_ECP_C=y
CONFIG_MBEDTLS_ECP_DP_SECP256R1_ENABLED=y

# Enable networking
CONFIG_NETWORKING=y

# Sockets
CONFIG_NET_SOCKETS=y
CONFIG_NET_SOCKETS_SOCKOPT_TLS=y

# Use DHCP for IPv4 and IPv6
CONFIG_NET_DHCPV4=y
CONFIG_NET_DHCPV6=y

# Generic networking options
CONFIG_NET_MGMT_EVENT_STACK_SIZE=4096
CONFIG_NET_TX_STACK_SIZE=4096
CONFIG_NET_RX_STACK_SIZE=4096
CONFIG_NET_PKT_RX_COUNT=20
CONFIG_NET_PKT_TX_COUNT=20
CONFIG_NET_BUF_RX_COUNT=40
CONFIG_NET_BUF_TX_COUNT=40
CONFIG_NET_MAX_CONTEXTS=20
CONFIG_NET_MAX_CONN=6
CONFIG_NET_MGMT=y
CONFIG_NET_MGMT_EVENT=y
CONFIG_NET_IPV4=y
CONFIG_NET_IPV6=y
CONFIG_NET_TCP=y

# Enable HTTP client
CONFIG_HTTP_CLIENT=y

# MQTT options
CONFIG_MQTT_LIB=y
CONFIG_MQTT_LIB_TLS=y
CONFIG_MQTT_KEEPALIVE=60

# Enable flash
CONFIG_FLASH=y
CONFIG_FLASH_MAP=y
CONFIG_FLASH_PAGE_LAYOUT=y

# Enable NVS
CONFIG_NVS=y
CONFIG_NVS_LOG_LEVEL_WRN=y

# Enable storage
CONFIG_ZMS=y
CONFIG_ZMS_LOG_LEVEL_WRN=y

# Enable hash functions
CONFIG_SYS_HASH_FUNC32=y
CONFIG_SYS_HASH_FUNC32_MURMUR3=y

# Configure the name of the binary
# This will also be used to identify the edgehog image
CONFIG_KERNEL_BIN_NAME="sample-edgehog-app"

# Edgehog depends on
CONFIG_IMG_MANAGER=y
CONFIG_STREAM_FLASH=y
CONFIG_REBOOT=y

CONFIG_DNS_RESOLVER_AI_MAX_ENTRIES=4
CONFIG_NET_SOCKETS_TLS_MAX_CONTEXTS=4
CONFIG_TLS_MAX_CREDENTIALS_NUMBER=8

CONFIG_THREAD_MONITOR=y
CONFIG_INIT_STACKS=y
CONFIG_THREAD_STACK_INFO=y

CONFIG_ZVFS_OPEN_MAX=26

CONFIG_SNTP=y
CONFIG_NET_CONFIG_CLOCK_SNTP_INIT=y
CONFIG_NET_CONFIG_SNTP_INIT_SERVER="0.pool.ntp.org"
CONFIG_NET_CONFIG_SNTP_INIT_TIMEOUT=3000

# Enable the settings
CONFIG_SETTINGS=y

# Activate Zbus
CONFIG_ZBUS=y

# Set thread names
CONFIG_THREAD_NAME=y

# Enable UUID
CONFIG_UUID=y
CONFIG_UUID_V4=y
CONFIG_UUID_V5=y
CONFIG_UUID_BASE64=y
```

## boards/nrf7002dk_nrf5340_cpuapp.conf
```kconfig
# (C) Copyright 2024, SECO Mind Srl
#
# SPDX-License-Identifier: Apache-2.0

# Use a small log buffer size
# CONFIG_LOG_BUFFER_SIZE=8192

# TODO substitute this with a real randomness source
CONFIG_TEST_RANDOM_GENERATOR=y

# Config WiFi for this board
CONFIG_WIFI=y

# Disable crc32 in zlib to avoid conflicts
CONFIG_ZLIB_NO_CRC32=y
```

## boards/nrf7002dk_nrf5340_cpuapp.overlay
```dts
/*
 * (C) Copyright 2024, SECO Mind Srl
 *
 * SPDX-License-Identifier: Apache-2.0
 */

/delete-node/ &storage_partition;

&flash0 {
	partitions {
		compatible = "fixed-partitions";
		#address-cells = <1>;
		#size-cells = <1>;

		storage_partition: partition@f8000 {
			label = "storage";
			reg = <0x000f8000 0x00002000>;
		};

		astarte_partition: partition@fA000 {
			label = "astarte";
			reg = <0x000fA000 0x00006000>;
		};
	};
};
```

## boards/stm32h573i_dk.overlay
```dts
/*
 * (C) Copyright 2024, SECO Mind Srl
 *
 * SPDX-License-Identifier: Apache-2.0
 */

&flash0 {
	partitions {
		astarte_partition: partition@130000 {
			label = "astarte";
			reg = <0x00130000 DT_SIZE_K(128)>;
		};
		edgehog_partition: partition@150000 {
			label = "edgehog_storage";
			reg = <0x00150000 DT_SIZE_K(64)>;
		};
	};
};

/* Requires the following to be manually added in the ./zephyr/boards/arm/stm32h573i_dk/stm32h573i_dk.dts file */
/*
&flash0 {
	partitions {
		compatible = "fixed-partitions";
		#address-cells = <1>;
		#size-cells = <1>;

		/* Set the partitions with first MB to make use of the whole Bank1 */
		boot_partition: partition@0 {
			label = "mcuboot";
			reg = <0x00000000 DT_SIZE_K(64)>;
		};
		slot0_partition: partition@10000 {
			label = "image-0";
			reg = <0x00010000 DT_SIZE_K(512)>;
		};
		slot1_partition: partition@90000 {
			label = "image-1";
			reg = <0x00090000 DT_SIZE_K(512)>;
		};
		scratch_partition: partition@110000 {
			label = "image-scratch";
			reg = <0x00110000 DT_SIZE_K(64)>;
		};
		/* Set 64KB of storage at the end of Bank1 */
		storage_partition: partition@120000 {
			label = "storage";
			reg = <0x00120000 DT_SIZE_K(64)>;
		};
	};
};
*/
```

## src/main.c
```c
/*
 * (C) Copyright 2024, SECO Mind Srl
 *
 * SPDX-License-Identifier: Apache-2.0
 */

#include <time.h>

#include <zephyr/kernel.h>
#include <zephyr/net/net_mgmt.h>
#include <zephyr/net/sntp.h>
#include <zephyr/sys/clock.h>

#include <zephyr/logging/log.h>
LOG_MODULE_REGISTER(edgehog_app, CONFIG_APP_LOG_LEVEL); // NOLINT

#if (!defined(CONFIG_ASTARTE_DEVICE_SDK_DEVELOP_USE_NON_TLS_HTTP)                                  \
    || !defined(CONFIG_ASTARTE_DEVICE_SDK_DEVELOP_USE_NON_TLS_MQTT))
#include "ca_certificates.h"
#include <zephyr/net/tls_credentials.h>
#endif

#include <astarte_device_sdk/device.h>

#ifdef CONFIG_EDGEHOG_DEVICE_ZBUS_OTA_EVENT
#include <edgehog_device/ota_event.h>
#endif
#include <edgehog_device/device.h>
#include <edgehog_device/telemetry.h>

#ifdef CONFIG_WIFI
#include "wifi.h"
#else
#include "eth.h"
#endif

#ifdef CONFIG_EDGEHOG_DEVICE_FILE_TRANSFER
#include "file_transfer.h"
#endif

/************************************************
 *             Constants and defines            *
 ***********************************************/

#define MAIN_THREAD_PERIOD_MS 500
#define EDGEHOG_DEVICE_PERIOD_MS 100
#ifdef CONFIG_EDGEHOG_DEVICE_ZBUS_OTA_EVENT
#define ZBUS_PERIOD_MS 500
#endif

#define HTTP_TIMEOUT_MS (3 * MSEC_PER_SEC)
#define MQTT_FIRST_POLL_TIMEOUT_MS (3 * MSEC_PER_SEC)
#define MQTT_POLL_TIMEOUT_MS 200

#define TELEMETRY_SYSTEM_STATUS_PERIOD_S 5
#define TELEMETRY_WIFI_SCAN_PERIOD_S 30

// NOLINTBEGIN(cppcoreguidelines-avoid-non-const-global-variables)
enum device_tread_flags
{
    DEVICE_THREADS_FLAGS_TERMINATION = 1U,
    DEVICE_THREADS_FLAGS_CONNECT_ASTARTE,
    DEVICE_THREADS_FLAGS_START_EDGEHOG,

};
static atomic_t device_threads_flags;

K_THREAD_STACK_DEFINE(edgehog_device_thread_stack_area, CONFIG_EDGEHOG_DEVICE_THREAD_STACK_SIZE);
static struct k_thread edgehog_device_thread_data;

static edgehog_device_handle_t edgehog_device;

#ifdef CONFIG_EDGEHOG_DEVICE_ZBUS_OTA_EVENT
K_THREAD_STACK_DEFINE(zbus_thread_stack_area, CONFIG_ZBUS_THREAD_STACK_SIZE);
static struct k_thread zbus_thread_data;
// Define a zbus subscriber and add it as an observer to the Edgehog OTA channel
#define EDGEHOG_OTA_SUBSCRIBER_NOTIFICATION_QUEUE_SIZE 5
#define EDGEHOG_OTA_OBSERVER_NOTIFY_PRIORITY 5
ZBUS_SUBSCRIBER_DEFINE(edgehog_ota_subscriber, EDGEHOG_OTA_SUBSCRIBER_NOTIFICATION_QUEUE_SIZE);
ZBUS_CHAN_ADD_OBS(edgehog_ota_chan, edgehog_ota_subscriber, EDGEHOG_OTA_OBSERVER_NOTIFY_PRIORITY);
#endif
// NOLINTEND(cppcoreguidelines-avoid-non-const-global-variables)

/************************************************
 *         Static functions declarations        *
 ***********************************************/

/**
 * @brief Initialize System Time
 */
static void system_time_init(void);
/**
 * @brief Entry point for the Astarte device thread.
 *
 * @param arg1 Unused argument.
 * @param arg2 Unused argument.
 * @param arg3 Unused argument.
 */
static void edgehog_device_thread_entry_point(void *arg1, void *arg2, void *arg3);
#ifdef CONFIG_EDGEHOG_DEVICE_ZBUS_OTA_EVENT
/**
 * @brief Entry point for the Zbus reception thread.
 *
 * @param arg1 Unused argument.
 * @param arg2 Unused argument.
 * @param arg3 Unused argument.
 */
static void zbus_thread_entry_point(void *arg1, void *arg2, void *arg3);
#endif
#ifdef CONFIG_EDGEHOG_DEVICE_ZBUS_OTA_EVENT
/**
 * @brief Listen on the Edgehog zbus channel for events.
 *
 * @param timeout The timeout used for listening. In case of a received notification this timeout
 * is also used for reading the message.
 */
static void edgehog_listen_zbus_channel(k_timeout_t timeout);
#endif

/************************************************
 *         Global functions definition          *
 ***********************************************/

// NOLINTNEXTLINE(hicpp-function-size)
int main(void)
{
    LOG_INF("Edgehog device sample"); // NOLINT
    LOG_INF("Board: %s", CONFIG_BOARD); // NOLINT

#ifdef CONFIG_WIFI
    LOG_INF("Initializing WiFi driver."); // NOLINT
    app_wifi_init();
    k_sleep(K_SECONDS(5));
    const char *ssid = CONFIG_WIFI_SSID;
    enum wifi_security_type sec = WIFI_SECURITY_TYPE_PSK;
    const char *psk = CONFIG_WIFI_PASSWORD;
    if (app_wifi_connect(ssid, sec, psk) != 0) {
        LOG_ERR("Connectivity intialization failed!"); // NOLINT
        return -1;
    }
#else
    LOG_INF("Initializing Ethernet driver."); // NOLINT
    if (eth_connect() != 0) {
        LOG_ERR("Connectivity intialization failed!"); // NOLINT
        return -1;
    }
#endif

    // Add TLS certificate for Astarte if required
#if (!defined(CONFIG_ASTARTE_DEVICE_SDK_DEVELOP_USE_NON_TLS_HTTP)                                  \
    || !defined(CONFIG_ASTARTE_DEVICE_SDK_DEVELOP_USE_NON_TLS_MQTT))
    tls_credential_add(CONFIG_ASTARTE_DEVICE_SDK_HTTPS_CA_CERT_TAG, TLS_CREDENTIAL_CA_CERTIFICATE,
        astarte_ca_certificate_root, sizeof(astarte_ca_certificate_root));
#endif
    // Add TLS certificate for Edgehog if required
#ifndef CONFIG_EDGEHOG_DEVICE_DEVELOP_USE_NON_TLS_HTTP
    tls_credential_add(CONFIG_EDGEHOG_DEVICE_OTA_HTTPS_CA_CERT_TAG, TLS_CREDENTIAL_CA_CERTIFICATE,
        edgehog_ota_ca_certificate_root, sizeof(edgehog_ota_ca_certificate_root));
#ifdef CONFIG_EDGEHOG_DEVICE_FILE_TRANSFER_HTTPS_CA_CERT_TAG
    tls_credential_add(CONFIG_EDGEHOG_DEVICE_FILE_TRANSFER_HTTPS_CA_CERT_TAG,
        TLS_CREDENTIAL_CA_CERTIFICATE, edgehog_ft_ca_certificate_root,
        sizeof(edgehog_ft_ca_certificate_root));
#endif
#endif

    // Initalize the system time
    system_time_init();

    // Spawn a new thread for the Edgehog device
    k_tid_t thread_id = k_thread_create(&edgehog_device_thread_data,
        edgehog_device_thread_stack_area, K_THREAD_STACK_SIZEOF(edgehog_device_thread_stack_area),
        edgehog_device_thread_entry_point, NULL, NULL, NULL, CONFIG_EDGEHOG_DEVICE_THREAD_PRIORITY,
        0, K_NO_WAIT);

#ifdef CONFIG_THREAD_NAME
    int ret = k_thread_name_set(thread_id, "sample_edgehog_device_thread");
    if (ret != 0) {
        LOG_ERR("Failed to set thread name, error %d", ret); // NOLINT
    }
#endif

    // Wait for a predefined operational time.
    k_timepoint_t finish_timepoint = sys_timepoint_calc(K_SECONDS(CONFIG_SAMPLE_DURATION_SECONDS));
    while (!K_TIMEOUT_EQ(sys_timepoint_timeout(finish_timepoint), K_NO_WAIT)) {
        k_timepoint_t timepoint = sys_timepoint_calc(K_MSEC(MAIN_THREAD_PERIOD_MS));
#ifndef CONFIG_WIFI
        if (eth_poll() != 0) {
            LOG_ERR("Failed polling Ethernet."); // NOLINT
        }
#endif
        k_sleep(sys_timepoint_timeout(timepoint));
    }

    // Signal to the Device threads that they should terminate.
    atomic_set_bit(&device_threads_flags, DEVICE_THREADS_FLAGS_TERMINATION);

    // Wait for the Edgehog thread to terminate.
    if (k_thread_join(&edgehog_device_thread_data, K_FOREVER) != 0) {
        LOG_ERR("Failed in waiting for the Edgehog thread to terminate."); // NOLINT
    }

    LOG_INF("Edgehog device sample finished."); // NOLINT
    k_sleep(K_MSEC(MSEC_PER_SEC));

    return 0;
}

/************************************************
 * Static functions definitions
 ***********************************************/

static void system_time_init()
{
#ifdef CONFIG_SNTP
    int ret = 0;
    struct sntp_time now;
    struct timespec tspec;

    ret = sntp_simple(
        CONFIG_NET_CONFIG_SNTP_INIT_SERVER, CONFIG_NET_CONFIG_SNTP_INIT_TIMEOUT, &now);
    if (ret == 0) {
        tspec.tv_sec = (time_t) now.seconds;
        // NOLINTBEGIN(bugprone-narrowing-conversions, hicpp-signed-bitwise,
        // readability-magic-numbers)
        tspec.tv_nsec = ((uint64_t) now.fraction * (1000lu * 1000lu * 1000lu)) >> 32;
        // NOLINTEND(bugprone-narrowing-conversions, hicpp-signed-bitwise,
        // readability-magic-numbers)
        sys_clock_settime(CLOCK_REALTIME, &tspec);
    }
#endif
}

static void edgehog_device_thread_entry_point(void *arg1, void *arg2, void *arg3)
{
    ARG_UNUSED(arg1);
    ARG_UNUSED(arg2);
    ARG_UNUSED(arg3);

    // Configuring the Astarte device used by the Edgehog device to communicate with the cloud
    // Edgehog instance. This device can also be leveraged by the user to send and receive data
    // through Astarte, check out the sample README for more information.
    char cred_secr[ASTARTE_PAIRING_CRED_SECR_LEN + 1] = CONFIG_ASTARTE_CREDENTIAL_SECRET;
    char device_id[ASTARTE_DEVICE_ID_LEN + 1] = CONFIG_ASTARTE_DEVICE_ID;

    astarte_device_config_t astarte_device_config = { 0 };
    astarte_device_config.http_timeout_ms = HTTP_TIMEOUT_MS;
    astarte_device_config.mqtt_connection_timeout_ms = MQTT_FIRST_POLL_TIMEOUT_MS;
    astarte_device_config.mqtt_poll_timeout_ms = MQTT_POLL_TIMEOUT_MS;
    memcpy(astarte_device_config.cred_secr, cred_secr, sizeof(cred_secr));
    memcpy(astarte_device_config.device_id, device_id, sizeof(device_id));

    edgehog_result_t eres = EDGEHOG_RESULT_OK;

#ifdef CONFIG_EDGEHOG_DEVICE_FILE_TRANSFER
    edgehog_ft_filesystem_partition_t ft_partitions[]
        = { { .mount_point = "/lfs1", .permissions = EDGEHOG_FT_FILESYSTEM_PERM_RW } };

    // Register /lfs1 as a user storage partition for storage-usage telemetry
    edgehog_storage_partition_t storage_partitions[]
        = { { .type = EDGEHOG_STORAGE_PARTITION_TYPE_FS, .path = "/lfs1" } };
#endif

    edgehog_telemetry_config_t telemetry_config[]
        = { {
                .type = EDGEHOG_TELEMETRY_SYSTEM_STATUS,
                .period_seconds = TELEMETRY_SYSTEM_STATUS_PERIOD_S,
            },
              {
                  .type = EDGEHOG_TELEMETRY_WIFI_SCAN,
                  .period_seconds = TELEMETRY_WIFI_SCAN_PERIOD_S,
              } };

    edgehog_device_config_t edgehog_conf = { .astarte_device_config = astarte_device_config,
        .telemetry_config = telemetry_config,
        .telemetry_config_len = ARRAY_SIZE(telemetry_config),
#ifdef CONFIG_EDGEHOG_DEVICE_FILE_TRANSFER
        .file_transfer_cbks = { .on_stream_transfer_start = app_on_stream_transfer_start,
            .on_filesystem_transfer_done = app_on_filesystem_transfer_done },
        .file_transfer_partitions = ft_partitions,
        .file_transfer_partitions_len = ARRAY_SIZE(ft_partitions),
        .storage_partitions = storage_partitions,
        .storage_partitions_len = ARRAY_SIZE(storage_partitions)
#endif
    };
    eres = edgehog_device_new(&edgehog_conf, &edgehog_device);
    if (eres != EDGEHOG_RESULT_OK) {
        LOG_ERR("Unable to create edgehog device handle"); // NOLINT
        goto exit;
    }

    eres = edgehog_device_start(edgehog_device);
    if (eres != EDGEHOG_RESULT_OK) {
        LOG_ERR("Unable to start edgehog device"); // NOLINT
        goto exit;
    }

#ifdef CONFIG_EDGEHOG_DEVICE_ZBUS_OTA_EVENT
    // Spawn a new thread for listening on Zbus device
    k_tid_t thread_id = k_thread_create(&zbus_thread_data, zbus_thread_stack_area,
        K_THREAD_STACK_SIZEOF(zbus_thread_stack_area), zbus_thread_entry_point, NULL, NULL, NULL,
        CONFIG_ZBUS_THREAD_PRIORITY, 0, K_NO_WAIT);

#ifdef CONFIG_THREAD_NAME
    int ret = k_thread_name_set(thread_id, "sample_zbus_ota_thread");
    if (ret != 0) {
        LOG_ERR("Failed to set thread name, error %d", ret); // NOLINT
    }
#endif
#endif

    while (!atomic_test_bit(&device_threads_flags, DEVICE_THREADS_FLAGS_TERMINATION)) {
        k_timepoint_t timepoint = sys_timepoint_calc(K_MSEC(EDGEHOG_DEVICE_PERIOD_MS));

        k_sleep(sys_timepoint_timeout(timepoint));
    }

    LOG_INF("End of sample, stopping Edgehog."); // NOLINT
    eres = edgehog_device_stop(edgehog_device, K_FOREVER);
    if (eres != EDGEHOG_RESULT_OK) {
        LOG_ERR("Unable to stop the edgehog device"); // NOLINT
        goto exit;
    }

    LOG_INF("Edgehog device will now be destroyed."); // NOLINT
    edgehog_device_destroy(edgehog_device);

exit:
    // Ensure to set the thread termination flag
    atomic_set_bit(&device_threads_flags, DEVICE_THREADS_FLAGS_TERMINATION);

#ifdef CONFIG_EDGEHOG_DEVICE_ZBUS_OTA_EVENT
    // Wait for the Zbus thread to terminate.
    if (k_thread_join(&zbus_thread_data, K_SECONDS(10)) != 0) {
        LOG_ERR("Failed in waiting for the Zbus thread to terminate."); // NOLINT
    }
#endif
}

#ifdef CONFIG_EDGEHOG_DEVICE_ZBUS_OTA_EVENT
static void zbus_thread_entry_point(void *arg1, void *arg2, void *arg3)
{
    ARG_UNUSED(arg1);
    ARG_UNUSED(arg2);
    ARG_UNUSED(arg3);

    while (!atomic_test_bit(&device_threads_flags, DEVICE_THREADS_FLAGS_TERMINATION)) {
        edgehog_listen_zbus_channel(K_MSEC(ZBUS_PERIOD_MS));
    }
}
#endif

#ifdef CONFIG_EDGEHOG_DEVICE_ZBUS_OTA_EVENT
static void edgehog_listen_zbus_channel(k_timeout_t timeout)
{
    const struct zbus_channel *chan = NULL;
    edgehog_ota_chan_event_t ota = { 0 };
    if ((zbus_sub_wait(&edgehog_ota_subscriber, &chan, timeout) == 0) && (&edgehog_ota_chan == chan)
        && (zbus_chan_read(chan, &ota, timeout) == 0)) {
        switch (ota.event) {
            case EDGEHOG_OTA_INIT_EVENT:
                LOG_WRN("To subscriber -> EDGEHOG_OTA_INIT_EVENT"); // NOLINT
                break;
            case EDGEHOG_OTA_PENDING_REBOOT_EVENT:
                LOG_WRN("To subscriber -> EDGEHOG_OTA_PENDING_REBOOT_EVENT"); // NOLINT
                edgehog_ota_chan_event_t ota_chan_event
                    = { .event = EDGEHOG_OTA_CONFIRM_REBOOT_EVENT };
                zbus_chan_pub(&edgehog_ota_chan, &ota_chan_event, K_SECONDS(1));
                break;
            case EDGEHOG_OTA_CONFIRM_REBOOT_EVENT:
                LOG_WRN("To subscriber -> EDGEHOG_OTA_CONFIRM_REBOOT_EVENT"); // NOLINT
                break;
            case EDGEHOG_OTA_FAILED_EVENT:
                LOG_WRN("To subscriber -> EDGEHOG_OTA_FAILED_EVENT"); // NOLINT
                break;
            case EDGEHOG_OTA_SUCCESS_EVENT:
                LOG_WRN("To subscriber -> EDGEHOG_OTA_SUCCESS_EVENT"); // NOLINT
                break;
            default:
                LOG_WRN("To subscriber -> EDGEHOG_OTA_INVALID_EVENT"); // NOLINT
        }
    }
}
#endif
```

## src/sample_config.c
```c
/*
 * (C) Copyright 2024, SECO Mind Srl
 *
 * SPDX-License-Identifier: Apache-2.0
 */

#include "sample_config.h"

#include <stdint.h>
#include <stdio.h>

#if defined(CONFIG_CONFIG_FROM_FLASH)
#include <zephyr/data/json.h>
#include <zephyr/device.h>
#include <zephyr/fs/fs.h>
#include <zephyr/fs/littlefs.h>
#include <zephyr/kernel.h>
#include <zephyr/logging/log.h>
#include <zephyr/storage/flash_map.h>
#endif

#include <zephyr/logging/log.h>
LOG_MODULE_REGISTER(config_file, CONFIG_APP_LOG_LEVEL); // NOLINT

/************************************************
 *       Checks over configuration values       *
 ***********************************************/

#if !defined(CONFIG_CONFIG_FROM_FLASH)
BUILD_ASSERT(sizeof(CONFIG_ASTARTE_DEVICE_ID) == ASTARTE_DEVICE_ID_LEN + 1,
    "Missing device ID in datastreams example");

BUILD_ASSERT(sizeof(CONFIG_ASTARTE_CREDENTIAL_SECRET) == ASTARTE_PAIRING_CRED_SECR_LEN + 1,
    "Missing credential secret in datastreams example");
#endif

/************************************************
 *        Defines, constants and typedef        *
 ***********************************************/

#if defined(CONFIG_CONFIG_FROM_FLASH)
/* Matches LFS_NAME_MAX */
#define MAX_PATH_LEN 255
#define MAX_CONFIG_FILE_SIZE 4096

#define PARTITION_NODE DT_NODELABEL(lfs1)

#if DT_NODE_EXISTS(PARTITION_NODE)
FS_FSTAB_DECLARE_ENTRY(PARTITION_NODE);
#else /* PARTITION_NODE */
#error "Could not find the littlefs partition!"
#endif /* PARTITION_NODE */

struct fs_mount_t *mountpoint = &FS_FSTAB_ENTRY(PARTITION_NODE);
#endif

/************************************************
 *         Static functions declaration         *
 ***********************************************/

static int copy_configuration(const char *device_id, const char *credential_secret,
    const char *wifi_ssid, const char *wifi_pwd, struct sample_config *out_cfg);
#if defined(CONFIG_CONFIG_FROM_FLASH)
static int read_configuration_file(
    char fname[static MAX_PATH_LEN], char fcontent[static MAX_CONFIG_FILE_SIZE]);
static int parse_configuration_file(char *fcontent, struct sample_config *out_cfg);
#endif

/************************************************
 * Global functions definition
 ***********************************************/

int sample_config_get(struct sample_config *cfg)
{
#if defined(CONFIG_CONFIG_FROM_FLASH)
    int rc;
    char config_fname[MAX_PATH_LEN] = { 0 };
    char config_fcontent[MAX_CONFIG_FILE_SIZE] = { 0 };

    rc = snprintf(
        config_fname, sizeof(config_fname), "%s/configuration.json", mountpoint->mnt_point);
    if (rc >= sizeof(config_fname)) {
        LOG_ERR("FAIL: snprinf [rd:%d]", rc);
        goto out;
    }

    rc = read_configuration_file(config_fname, config_fcontent);
    if (rc < 0) {
        goto out;
    }
    LOG_DBG("%s read content:%s (bytes: %d)", config_fname, config_fcontent, rc);

    rc = parse_configuration_file(config_fcontent, cfg);
    if (rc != 0) {
        goto out;
    }

out:
    rc = fs_unmount(mountpoint);
    LOG_INF("%s unmount: %d", mountpoint->mnt_point, rc);
    if (rc != 0) {
        return -1;
    }
    return 0;
#else
    return copy_configuration(CONFIG_ASTARTE_DEVICE_ID, CONFIG_ASTARTE_CREDENTIAL_SECRET,
#if defined(CONFIG_WIFI)
        CONFIG_WIFI_SSID, CONFIG_WIFI_PASSWORD,
#else
        NULL, NULL,
#endif
        cfg);
#endif
}

/************************************************
 * Static functions definitions
 ***********************************************/

static int copy_configuration(const char *device_id, const char *credential_secret,
    const char *wifi_ssid, const char *wifi_pwd, struct sample_config *out_cfg)
{
    // Copy the received credential secret in the output buffer
    int snprintf_rc = snprintf(out_cfg->device_id, ARRAY_SIZE(out_cfg->device_id), "%s", device_id);
    if ((snprintf_rc < 0) || (snprintf_rc >= ARRAY_SIZE(out_cfg->device_id))) {
        LOG_ERR("Error extracting the device ID from the parsed json.");
        return -1;
    }
    snprintf_rc = snprintf(out_cfg->credential_secret, ARRAY_SIZE(out_cfg->credential_secret), "%s",
        credential_secret);
    if ((snprintf_rc < 0) || (snprintf_rc >= ARRAY_SIZE(out_cfg->credential_secret))) {
        LOG_ERR("Error extracting the credential secret from the parsed json.");
        return -1;
    }
#if defined(CONFIG_WIFI)
    snprintf_rc = snprintf(out_cfg->wifi_ssid, ARRAY_SIZE(out_cfg->wifi_ssid), "%s", wifi_ssid);
    if ((snprintf_rc < 0) || (snprintf_rc >= ARRAY_SIZE(out_cfg->wifi_ssid))) {
        LOG_ERR("Error extracting the WiFi SSID from the parsed json.");
        return -1;
    }
    snprintf_rc = snprintf(out_cfg->wifi_pwd, ARRAY_SIZE(out_cfg->wifi_pwd), "%s", wifi_pwd);
    if ((snprintf_rc < 0) || (snprintf_rc >= ARRAY_SIZE(out_cfg->wifi_pwd))) {
        LOG_ERR("Error extracting the WiFi password from the parsed json.");
        return -1;
    }
#else
    ARG_UNUSED(wifi_ssid);
    ARG_UNUSED(wifi_pwd);
#endif
    return 0;
}
#if defined(CONFIG_CONFIG_FROM_FLASH)
static int read_configuration_file(
    char fname[static MAX_PATH_LEN], char fcontent[static MAX_CONFIG_FILE_SIZE])
{
    struct fs_file_t file;
    int rc, ret;

    fs_file_t_init(&file);
    rc = fs_open(&file, fname, FS_O_READ);
    if (rc < 0) {
        LOG_ERR("FAIL: open %s: %d", fname, rc);
        return rc;
    }

    rc = fs_read(&file, fcontent, MAX_CONFIG_FILE_SIZE);
    if (rc <= 0) {
        LOG_ERR("FAIL: read %s: [rd:%d]", fname, rc);
        goto out;
    }

out:
    ret = fs_close(&file);
    if (ret < 0) {
        LOG_ERR("FAIL: close %s: %d", fname, ret);
        return ret;
    }

    return rc;
}

static int parse_configuration_file(char *fcontent, struct sample_config *out_cfg)
{
    // Define the structure of the expected JSON file
    struct full_json_s
    {
        const char *deviceID;
        const char *credentialSecret;
        const char *wifiSsid;
        const char *wifiPassword;
    };
    // Create the descriptors list containing each element of the struct
    static const struct json_obj_descr full_json_descr[] = {
        JSON_OBJ_DESCR_PRIM(struct full_json_s, deviceID, JSON_TOK_STRING),
        JSON_OBJ_DESCR_PRIM(struct full_json_s, credentialSecret, JSON_TOK_STRING),
        JSON_OBJ_DESCR_PRIM(struct full_json_s, wifiSsid, JSON_TOK_STRING),
        JSON_OBJ_DESCR_PRIM(struct full_json_s, wifiPassword, JSON_TOK_STRING),
    };
    // This is only for the outside level, nested elements should be checked individually.
    int expected_return_code = (1U << (size_t) ARRAY_SIZE(full_json_descr)) - 1;
    // Parse the json into a structure
    struct full_json_s parsed_json
        = { .deviceID = NULL, .credentialSecret = NULL, .wifiSsid = NULL, .wifiPassword = NULL };
    int64_t ret = json_obj_parse(
        fcontent, strlen(fcontent) + 1, full_json_descr, ARRAY_SIZE(full_json_descr), &parsed_json);
    if (ret != expected_return_code) {
        LOG_ERR("JSON Parse Error: %lld", ret);
        return -1;
    }
    if (!parsed_json.deviceID) {
        LOG_ERR("Parsed JSON is missing the deviceID field.");
        return -1;
    }
    if (!parsed_json.credentialSecret) {
        LOG_ERR("Parsed JSON is missing the credentialSecret field.");
        return -1;
    }
    if (!parsed_json.wifiSsid) {
        LOG_ERR("Parsed JSON is missing the wifiSsid field.");
        return -1;
    }
    if (!parsed_json.wifiPassword) {
        LOG_ERR("Parsed JSON is missing the wifiPassword field.");
        return -1;
    }

    // Copy the received credential secret in the output buffer
    return copy_configuration(parsed_json.deviceID, parsed_json.credentialSecret,
        parsed_json.wifiSsid, parsed_json.wifiPassword, out_cfg);
}
#endif
```

## src/wifi.c
```c
/*
 * (C) Copyright 2024, SECO Mind Srl
 *
 * SPDX-License-Identifier: Apache-2.0
 */

#include "wifi.h"

#include <zephyr/kernel.h>
#include <zephyr/net/wifi_mgmt.h>

#include <zephyr/logging/log.h>
LOG_MODULE_REGISTER(wifi, CONFIG_APP_LOG_LEVEL); // NOLINT

/************************************************
 *        Defines, constants and typedef        *
 ***********************************************/

#define WIFI_SHELL_MGMT_EVENTS (NET_EVENT_WIFI_CONNECT_RESULT | NET_EVENT_WIFI_DISCONNECT_RESULT)

static struct net_mgmt_event_callback wifi_shell_mgmt_cb;
static struct net_mgmt_event_callback ipv4_cb;

static K_SEM_DEFINE(wifi_connected, 0, 1);
static K_SEM_DEFINE(ipv4_address_obtained, 0, 1);

/************************************************
 *       Callbacks declaration/definition       *
 ***********************************************/

static void wifi_mgmt_event_handler(struct net_mgmt_event_callback *event_cb,
				    uint32_t mgmt_event, struct net_if *iface)
{
    const struct wifi_status *status = (const struct wifi_status *) event_cb->info;
	switch (mgmt_event) {
	case NET_EVENT_WIFI_CONNECT_RESULT:
        if (status->status) {
            LOG_DBG("WiFi connection request failed (%d)", status->status);
            k_sem_take(&wifi_connected, K_NO_WAIT);
        } else {
            LOG_DBG("WiFi connected");
            k_sem_give(&wifi_connected);
        }
		break;
	case NET_EVENT_WIFI_DISCONNECT_RESULT:
        if (status->status) {
            LOG_DBG("WiFi disconnection error, status: (%d)", status->status);
            k_sem_take(&wifi_connected, K_NO_WAIT);
        } else {
            LOG_DBG("WiFi disconnected");
            k_sem_take(&wifi_connected, K_NO_WAIT);
        }
		break;
	default:
		break;
	}
}

static void ipv4_mgmt_event_handler(
    struct net_mgmt_event_callback *event_cb, uint32_t mgmt_event, struct net_if *iface)
{
    (void) event_cb;
    (void) iface;

    switch (mgmt_event) {

        case NET_EVENT_IPV4_ADDR_ADD:
            LOG_DBG("Network event: NET_EVENT_IPV4_ADDR_ADD."); // NOLINT
            k_sem_give(&ipv4_address_obtained);
            break;

        case NET_EVENT_IPV4_ADDR_DEL:
            LOG_DBG("Network event: NET_EVENT_IPV4_ADDR_DEL."); // NOLINT
            k_sem_take(&ipv4_address_obtained, K_NO_WAIT);
            break;

        default:
            break;
    }
}


/************************************************
 *         Global functions definitions         *
 ***********************************************/

void wifi_init(void)
{
	net_mgmt_init_event_callback(&wifi_shell_mgmt_cb,
				     wifi_mgmt_event_handler,
				     WIFI_SHELL_MGMT_EVENTS);
    net_mgmt_init_event_callback(&ipv4_cb, ipv4_mgmt_event_handler,
        NET_EVENT_IPV4_ADDR_ADD | NET_EVENT_IPV4_ADDR_DEL);

	net_mgmt_add_event_callback(&wifi_shell_mgmt_cb);
    net_mgmt_add_event_callback(&ipv4_cb);
}

int wifi_connect(const char *ssid, enum wifi_security_type sec, const char *psk)
{
    LOG_INF("Connecting through wifi..."); // NOLINT

	struct net_if *iface = net_if_get_wifi_sta();
	struct wifi_connect_req_params cnx_params = { 0 };
	int ret;

	cnx_params.band = WIFI_FREQ_BAND_UNKNOWN;
	cnx_params.channel = WIFI_CHANNEL_ANY;
	cnx_params.security = WIFI_SECURITY_TYPE_NONE;
	cnx_params.mfp = WIFI_MFP_OPTIONAL;

	cnx_params.ssid = ssid;
	cnx_params.ssid_length = strlen(cnx_params.ssid);
	cnx_params.security = sec;
	cnx_params.psk = psk;
	cnx_params.psk_length = strlen(cnx_params.psk);

	ret = net_mgmt(NET_REQUEST_WIFI_CONNECT, iface,
		       &cnx_params, sizeof(struct wifi_connect_req_params));
	if (ret) {
		LOG_ERR("Connection request failed with error: %d", ret);
		return -ENOEXEC;
	}

    LOG_INF("Waiting for WiFi to be connected.");
    while (k_sem_count_get(&wifi_connected) == 0) {
        k_sleep(K_MSEC(200));
    }

    net_dhcpv4_start(iface);

    LOG_INF("Waiting for an IPv4 address (DHCP)."); // NOLINT
    while (k_sem_count_get(&ipv4_address_obtained) == 0) {
        k_sleep(K_MSEC(200));
    }

    LOG_INF("WiFi ready..."); // NOLINT

	return 0;
}
```
