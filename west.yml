## west.yml
```yaml
# (C) Copyright 2024, SECO Mind Srl
#
# SPDX-License-Identifier: Apache-2.0

manifest:

  remotes:
    - name: zephyrproject-rtos
      url-base: https://github.com/zephyrproject-rtos
    - name: astarte-platform
      url-base: https://github.com/sorru94
    - name: secomind
      url-base: https://github.com/secomind

  projects:
    - name: zephyr
      remote: zephyrproject-rtos
      revision: v4.4.0
      import: true
    - name: astarte-device-sdk-zephyr
      remote: astarte-platform
      revision: zephyr-4.4-support
      import: true
```
